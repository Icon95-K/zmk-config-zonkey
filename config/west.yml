## config/west.yml
```yaml
manifest:
  remotes:
    - name: zmkfirmware
      url-base: https://github.com/zmkfirmware
    - name: kureyakey
      url-base: https://github.com/kureyakey
    - name: caksoylar
      url-base: https://github.com/caksoylar  
  projects:
    - name: zmk
      remote: zmkfirmware
      revision: studio   # ← ここを main → studio に変更
      import: app/west.yml
    - name: zmk-pmw3610-driver
      remote: kureyakey
      revision: main
    - name: zmk-rgbled-widget
      remote: caksoylar
      revision: main
  self:
    path: config
```
